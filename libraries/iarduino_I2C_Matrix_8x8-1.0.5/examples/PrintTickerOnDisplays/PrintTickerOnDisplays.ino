// Данный пример выводит бегущую строку на несколько дисплеев.   //
                                                                 //
#include <Wire.h>                                                // Подключаем библиотеку для работы с аппаратной шиной I2C.
#include <iarduino_I2C_Matrix_8x8.h>                             // Подключаем библиотеку для работы с LED матрицей 8x8.
iarduino_I2C_Matrix_8x8 disp[] = {9, 10, 11};                    // Объявляем массив объектов disp для работы с LED матрицами 8x8, сколько адресов указано, на столько дисплеев и будет выводиться текст.
uint16_t                k, p;                                    // Объявляем переменные: k-количество дисплеев, p-счетчик совершённых сдвигов.
String                  ticker = "Интернет магазин iarduino.ru расположен по адресу г.Москва, Леснорядский пер., 18с2, БЦ \"ДМ-ПРЕСС\".    Мы работаем ПН-ПТ с 12:00 до 18:00    тел: 8(499)5001456";
                                                                 //
void setup(){                                                    //
    delay(500);                                                  // Ждём завершение переходных процессов связанных с подачей питания.
    k = sizeof(disp)/sizeof(iarduino_I2C_Matrix_8x8); p=65500;   // Определяем количество дисплеев 'k' и устанавливаем счётчик 'p' в максимальное значение.
    for(int i=0; i<k; i++){                                      // Проходим по всем дисплеям ...
        disp[i].begin();                                         // Инициируем работу с LED матрицей 8x8.
        disp[i].bright(255);                                     // Устанавливаем максимальную яркость.
        disp[i].codingDetect("п");                               // Выполняем автоопределение кодировки скетча.
        disp[i].print(ticker);                                   // Загружаем текст бегущей строки в матрицу. Текст только загрузится, но не начнёт выводиться!
    }                                                            //
}                                                                //
                                                                 //
void loop(){                                                     //
    p++;                                                         // Увеличиваем счётчик совершённых сдвигов на 1 шаг.
    if(p>=disp[0].getScroolWidth()+disp[0].getCharIndent()-8*k){ // Если строка прокручена полностью (количество сдвигов равно или превысило количество пикселей в строке), то ...
        p = 0;                                                   // Сбрасываем счётчик совершённых сдвигов.
        delay(1000);                                             // Ждём 1 сек (задержка на последнем символе строки).
        for(int i=0; i<k; i++){disp[i].clrScr();}                // Чистим каждый дисплей.
        delay(1000);                                             // Ждём 1 сек (пауза между прокрутками бегущих строк).
        for(int i=0; i<k; i++){disp[i].scrollPos(i*8);}          // Выводим бегущую строку на дисплей в позиции зависящей от положения дисплея.
        delay(1000);                                             // Ждём 1 сек (задержка на первом символе строки).
    }                                                            //
    for(int i=0; i<k; i++){ disp[i].scrollStep(); }              // Сдвигаем строку каждого дисплея на один шаг.
    delay(50);                                                   // Приостанавливаем выполнение кода, чем больше задержка, тем медленнее скорость бегущей строки.
}                                                                //
