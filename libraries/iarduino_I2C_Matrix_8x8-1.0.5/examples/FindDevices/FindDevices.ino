// Данный пример ищет модули на шине и выводит информацию о них.  //
                                                                  //
#include <Wire.h>                                                 // Подключаем библиотеку для работы с аппаратной шиной I2C.
                                                                  //
void setup(){                                                     //
    uint8_t i,j,k[4],f=1;                                         // Объявляем переменные.
    Wire.begin();                                                 // Инициируем работу по шине I2C в качестве мастера.
    Serial.begin(9600);                                           // Инициируем передачу данных в монитор последовательного порта на скорости 9600 бит/сек.
    while(!Serial){;}                                             //
    delay(500);                                                   // Ждём завершение переходных процессов связанных с подачей питания.
    Serial.println("Поиск устройств на шине I2C ... ");           //
//  Проходим по всем доступным адресам на шине I2C:               //
    for(i=7; i<127; i++){                                         // Проходим по всем доступным адресам на шине I2C ...
      Wire.beginTransmission(i);                                  // Инициируем передачу данных по шине I2C к устройству с адресом i и битом RW=0 (запись). При этом сама передача не начнётся.
      Wire.write(0x04);                                           // Указываем единственный байт который мы хотим передать (это номер регистра).
    j=Wire.endTransmission();                                     // Выполняем инициированную ранее передачу данных.
      if(j==0){                                                   // Если передача выполнена успешно (0-передача успешна / 1 - переполнен буфер для передачи / 2 - получен NACK при передаче адреса / 3 - получен NACK при передаче данных / 4 - другая ошибка), то ...
        f=0;                                                      // Сбрасываем флаг f указывающий на отсутствие устройств на шине I2C.
        Serial.print("Устройство с адресом ");                    //
        Serial.print(i);                                          //
        Wire.requestFrom( i, uint8_t(4) );                        // Инициируем получение данных по шине I2C от устройства с адресом i и битом RW=1 (чтение). Второй аргумент функции указывает количество байт которое мы желаем прочитать.
        while(Wire.available()){k[j]=Wire.read(); j++;}           // Сохраняем все полученные данные в массив k.
        if( ((k[2]>>1)==i) && ((k[3]==0xC3)||(k[3]==0x3C)) ){     // Если значение второго элемента массива k совпадает с адресом устройства, а в третьем элементе хранится идентификатор 0xC3 или 0x3C значит это светодиодная матрица, или модуль серии metro, или модуль серии flash.
                      Serial.print(" является ");                 //
          if(k[0]==1){Serial.print("кнопкой");             }else  // Если в нулевом элементе массива k хранится значение 1, значит это кнопка.
          if(k[0]==2){Serial.print("светодиодом");         }else  // Если в нулевом элементе массива k хранится значение 2, значит это RGB светодиод.
          if(k[0]==3){Serial.print("потенциометром");      }else  // Если в нулевом элементе массива k хранится значение 3, значит это потенциометр.
          if(k[0]==4){Serial.print("звукоизлучателем");    }else  // Если в нулевом элементе массива k хранится значение 4, значит это звукоизлучатель.
          if(k[0]==5){Serial.print("датчиком DHT");        }else  // Если в нулевом элементе массива k хранится значение 5, значит это датчик влажности и температуры.
          if(k[0]==6){Serial.print("датчиком света");      }else  // Если в нулевом элементе массива k хранится значение 6, значит это датчик света.
          if(k[0]==7){Serial.print("расширителем выводов");}else  // Если в нулевом элементе массива k хранится значение 6, значит это датчик света.
          if(k[0]==8){Serial.print("LED матрицей");        }else  // Если в нулевом элементе массива k хранится значение 8, значит это светодиодная матрица.
                     {Serial.print("неизвестным модулем"); }      // Если в нулевом элементе массива k хранится иное значение, значит этот модуль был создан позднее чем данный скетч, или на одном адресе находятся несколько устройств.
                      Serial.print(" с версией прошивки ");       //
                      Serial.print(k[1]);                         // В первом элемента массива k хранится версия прошивки модуля.
                      Serial.println(".");                        //
        }else        {Serial.println(" не опознано.");}           //
      }                                                           //
    }                                                             //
    if( f )         {Serial.println("Устройства не найдены.");}   //
}                                                                 //
                                                                  //
void loop(){                                                      //
}                                                                 //